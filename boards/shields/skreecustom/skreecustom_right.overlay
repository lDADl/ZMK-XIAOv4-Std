/*
 * Copyright (c) 2024 The ZMK Contributors
 * SPDX-License-Identifier: MIT
 */

#include "skreecustom.dtsi"

&kscan0 {
    // This overlay defines the matrix columns for the RIGHT half.
    col-gpios
        = <&pro_micro 6 (GPIO_ACTIVE_HIGH)>  // Was P1_06
          <&pro_micro 5 (GPIO_ACTIVE_HIGH)>  // Was P1_04
          <&pro_micro 2 (GPIO_ACTIVE_HIGH)>  // Was P0_11
          <&pro_micro 3 (GPIO_ACTIVE_HIGH)>  // Was P1_00
          <&pro_micro 4 (GPIO_ACTIVE_HIGH)>  // Was P0_24
          <&pro_micro 18 (GPIO_ACTIVE_HIGH)> // Was P0_22
        ;
};
